## recipes_backup/meta-python/conf/layer.conf
```bitbake
# We have a conf and classes directory, add to BBPATH
BBPATH .= ":${LAYERDIR}"

# We have recipes-* directories, add to BBFILES
BBFILES += "${LAYERDIR}/recipes-*/*/*.bb \
            ${LAYERDIR}/recipes-*/*/*.bbappend"

BBFILE_COLLECTIONS += "meta-python"
BBFILE_PATTERN_meta-python = "^${LAYERDIR}/"
BBFILE_PRIORITY_meta-python = "6"

LAYERDEPENDS_meta-python = "core"
LAYERSERIES_COMPAT_meta-python = "scarthgap"
```

## recipes_backup/meta-toolchain/conf/layer.conf
```bitbake
# We have a conf and classes directory, add to BBPATH
BBPATH .= ":${LAYERDIR}"

# We have recipes-* directories, add to BBFILES
BBFILES += "${LAYERDIR}/recipes-*/*/*.bb \
            ${LAYERDIR}/recipes-*/*/*.bbappend"

BBFILE_COLLECTIONS += "meta-toolchain"
BBFILE_PATTERN_meta-toolchain = "^${LAYERDIR}/"
BBFILE_PRIORITY_meta-toolchain = "6"

LAYERDEPENDS_meta-toolchain = "core"
LAYERSERIES_COMPAT_meta-toolchain = "scarthgap"
```

## recipes_backup/rpi4/conf/bblayers.conf
```bitbake
# POKY_BBLAYERS_CONF_VERSION is increased each time build/conf/bblayers.conf
# changes incompatibly
POKY_BBLAYERS_CONF_VERSION = "2"

BBPATH = "${TOPDIR}"
BBFILES ?= ""

BBLAYERS ?= " \
  /home/kevinl/Documents/T6_KevinLoboJuarez/poky/meta \
  /home/kevinl/Documents/T6_KevinLoboJuarez/poky/meta-poky \
  /home/kevinl/Documents/T6_KevinLoboJuarez/poky/meta-yocto-bsp \
  /home/kevinl/Documents/T6_KevinLoboJuarez/poky/meta-raspberrypi \
  /home/kevinl/Documents/T6_KevinLoboJuarez/poky/meta-webcam \
  /home/kevinl/Documents/T6_KevinLoboJuarez/poky/meta-toolchain \
  /home/kevinl/Documents/T6_KevinLoboJuarez/poky/meta-python \
"
```
